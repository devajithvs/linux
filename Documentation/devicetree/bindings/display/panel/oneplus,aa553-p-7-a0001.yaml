## Documentation/devicetree/bindings/media/qcom,sm7675-camss.yaml
```yaml
# SPDX-License-Identifier: (GPL-2.0 OR BSD-2-Clause)
%YAML 1.2
---
$id: http://devicetree.org/schemas/media/qcom,sm7675-camss.yaml#
$schema: http://devicetree.org/meta-schemas/core.yaml#

title: Qualcomm SM7675 Camera Subsystem (CAMSS)

maintainers:
  - Devajith V S <devajithvs@gmail.com>

description:
  The CAMSS IP is a CSI decoder and ISP present on Qualcomm platforms.
  SM7675 carries five CSIPHY, three CSID and three VFE blocks of the
  SM8650 gen3 family.

properties:
  compatible:
    const: qcom,sm7675-camss

  reg:
    maxItems: 12

  reg-names:
    items:
      - const: csid_wrapper
      - const: csid0
      - const: csid1
      - const: csid2
      - const: csiphy0
      - const: csiphy1
      - const: csiphy2
      - const: csiphy3
      - const: csiphy4
      - const: vfe0
      - const: vfe1
      - const: vfe2

  clocks:
    maxItems: 26

  clock-names:
    items:
      - const: camnoc_axi
      - const: cpas_ahb
      - const: cpas_fast_ahb
      - const: cpas_vfe0
      - const: cpas_vfe1
      - const: cpas_vfe2
      - const: csid
      - const: csiphy0
      - const: csiphy0_timer
      - const: csiphy1
      - const: csiphy1_timer
      - const: csiphy2
      - const: csiphy2_timer
      - const: csiphy3
      - const: csiphy3_timer
      - const: csiphy4
      - const: csiphy4_timer
      - const: csiphy_rx
      - const: gcc_axi_hf
      - const: qdss_debug_xo
      - const: vfe0
      - const: vfe0_fast_ahb
      - const: vfe1
      - const: vfe1_fast_ahb
      - const: vfe2
      - const: vfe2_fast_ahb

  interrupts:
    maxItems: 11

  interrupt-names:
    items:
      - const: csid0
      - const: csid1
      - const: csid2
      - const: csiphy0
      - const: csiphy1
      - const: csiphy2
      - const: csiphy3
      - const: csiphy4
      - const: vfe0
      - const: vfe1
      - const: vfe2

  interconnects:
    maxItems: 2

  interconnect-names:
    items:
      - const: ahb
      - const: hf_mnoc

  iommus:
    maxItems: 3

  power-domains:
    items:
      - description: IFE0 GDSC - Image Front End, Global Distributed Switch Controller.
      - description: IFE1 GDSC - Image Front End, Global Distributed Switch Controller.
      - description: IFE2 GDSC - Image Front End, Global Distributed Switch Controller.
      - description: Titan GDSC - Titan ISP Block, Global Distributed Switch Controller.

  power-domain-names:
    items:
      - const: ife0
      - const: ife1
      - const: ife2
      - const: top

  ports:
    $ref: /schemas/graph.yaml#/properties/ports

    description:
      CSI input ports.

    patternProperties:
      "^port@[0-4]$":
        $ref: /schemas/graph.yaml#/$defs/port-base
        unevaluatedProperties: false

        description:
          Input port for receiving CSI data from a CSIPHY.

        properties:
          endpoint:
            $ref: video-interfaces.yaml#
            unevaluatedProperties: false

            properties:
              data-lanes:
                minItems: 1
                maxItems: 4

              bus-type:
                enum:
                  - 1 # MEDIA_BUS_TYPE_CSI2_CPHY
                  - 4 # MEDIA_BUS_TYPE_CSI2_DPHY

            required:
              - data-lanes

  vdd-csiphy01-0p9-supply:
    description:
      Phandle to a 0.9V regulator supply to CSIPHY0 and CSIPHY1 IP blocks.

  vdd-csiphy01-1p2-supply:
    description:
      Phandle to a 1.2V regulator supply to CSIPHY0 and CSIPHY1 IP blocks.

  vdd-csiphy24-0p9-supply:
    description:
      Phandle to a 0.9V regulator supply to CSIPHY2 and CSIPHY4 IP blocks.

  vdd-csiphy24-1p2-supply:
    description:
      Phandle to a 1.2V regulator supply to CSIPHY2 and CSIPHY4 IP blocks.

  vdd-csiphy35-0p9-supply:
    description:
      Phandle to a 0.9V regulator supply to CSIPHY3 and CSIPHY5 IP blocks.

  vdd-csiphy35-1p2-supply:
    description:
      Phandle to a 1.2V regulator supply to CSIPHY3 and CSIPHY5 IP blocks.

required:
  - compatible
  - reg
  - reg-names
  - clocks
  - clock-names
  - interconnects
  - interconnect-names
  - interrupts
  - interrupt-names
  - iommus
  - power-domains
  - power-domain-names

additionalProperties: false

examples:
  - |
    #include <dt-bindings/clock/qcom,palawan-camcc.h>
    #include <dt-bindings/clock/qcom,palawan-gcc.h>
    #include <dt-bindings/interconnect/qcom,palawan-rpmh.h>
    #include <dt-bindings/interrupt-controller/arm-gic.h>

    soc {
        #address-cells = <2>;
        #size-cells = <2>;

        isp@acb6000 {
            compatible = "qcom,sm7675-camss";
            reg = <0 0x0acb6000 0 0x1000>,
                  <0 0x0acb8000 0 0x1000>,
                  <0 0x0acba000 0 0x1000>,
                  <0 0x0acbc000 0 0x1000>,
                  <0 0x0ace4000 0 0x2000>,
                  <0 0x0ace6000 0 0x2000>,
                  <0 0x0ace8000 0 0x2000>,
                  <0 0x0acea000 0 0x2000>,
                  <0 0x0acec000 0 0x2000>,
                  <0 0x0ac62000 0 0xf000>,
                  <0 0x0ac71000 0 0xf000>,
                  <0 0x0ac80000 0 0xf000>;
            reg-names = "csid_wrapper", "csid0", "csid1", "csid2",
                        "csiphy0", "csiphy1", "csiphy2", "csiphy3",
                        "csiphy4", "vfe0", "vfe1", "vfe2";
            clocks = <&camcc CAM_CC_CAMNOC_AXI_RT_CLK>,
                     <&camcc CAM_CC_CPAS_AHB_CLK>,
                     <&camcc CAM_CC_CPAS_FAST_AHB_CLK>,
                     <&camcc CAM_CC_CPAS_IFE_0_CLK>,
                     <&camcc CAM_CC_CPAS_IFE_1_CLK>,
                     <&camcc CAM_CC_CPAS_IFE_2_CLK>,
                     <&camcc CAM_CC_CSID_CLK>,
                     <&camcc CAM_CC_CSIPHY0_CLK>,
                     <&camcc CAM_CC_CSI0PHYTIMER_CLK>,
                     <&camcc CAM_CC_CSI1PHYTIMER_CLK>,
                     <&camcc CAM_CC_CSIPHY1_CLK>,
                     <&camcc CAM_CC_CSI2PHYTIMER_CLK>,
                     <&camcc CAM_CC_CSIPHY2_CLK>,
                     <&camcc CAM_CC_CSI3PHYTIMER_CLK>,
                     <&camcc CAM_CC_CSIPHY3_CLK>,
                     <&camcc CAM_CC_CSI4PHYTIMER_CLK>,
                     <&camcc CAM_CC_CSIPHY4_CLK>,
                     <&camcc CAM_CC_CSID_CSIPHY_RX_CLK>,
                     <&gcc GCC_CAMERA_HF_AXI_CLK>,
                     <&camcc CAM_CC_QDSS_DEBUG_XO_CLK>,
                     <&camcc CAM_CC_IFE_0_CLK>,
                     <&camcc CAM_CC_IFE_0_FAST_AHB_CLK>,
                     <&camcc CAM_CC_IFE_1_CLK>,
                     <&camcc CAM_CC_IFE_1_FAST_AHB_CLK>,
                     <&camcc CAM_CC_IFE_2_CLK>,
                     <&camcc CAM_CC_IFE_2_FAST_AHB_CLK>;
            clock-names = "camnoc_axi", "cpas_ahb", "cpas_fast_ahb",
                          "cpas_vfe0", "cpas_vfe1", "cpas_vfe2", "csid",
                          "csiphy0", "csiphy0_timer", "csiphy1",
                          "csiphy1_timer", "csiphy2", "csiphy2_timer",
                          "csiphy3", "csiphy3_timer", "csiphy4",
                          "csiphy4_timer", "csiphy_rx", "gcc_axi_hf",
                          "qdss_debug_xo", "vfe0", "vfe0_fast_ahb",
                          "vfe1", "vfe1_fast_ahb", "vfe2", "vfe2_fast_ahb";
            interrupts = <GIC_SPI 601 IRQ_TYPE_EDGE_RISING>,
                         <GIC_SPI 603 IRQ_TYPE_EDGE_RISING>,
                         <GIC_SPI 431 IRQ_TYPE_EDGE_RISING>,
                         <GIC_SPI 477 IRQ_TYPE_EDGE_RISING>,
                         <GIC_SPI 478 IRQ_TYPE_EDGE_RISING>,
                         <GIC_SPI 479 IRQ_TYPE_EDGE_RISING>,
                         <GIC_SPI 448 IRQ_TYPE_EDGE_RISING>,
                         <GIC_SPI 122 IRQ_TYPE_EDGE_RISING>,
                         <GIC_SPI 602 IRQ_TYPE_EDGE_RISING>,
                         <GIC_SPI 604 IRQ_TYPE_EDGE_RISING>,
                         <GIC_SPI 688 IRQ_TYPE_EDGE_RISING>;
            interrupt-names = "csid0", "csid1", "csid2", "csiphy0",
                              "csiphy1", "csiphy2", "csiphy3", "csiphy4",
                              "vfe0", "vfe1", "vfe2";
            interconnects = <&gem_noc MASTER_APPSS_PROC 0
                             &config_noc SLAVE_CAMERA_CFG 0>,
                            <&mmss_noc MASTER_CAMNOC_HF 0
                             &mc_virt SLAVE_EBI1 0>;
            interconnect-names = "ahb", "hf_mnoc";
            iommus = <&apps_smmu 0x800 0x20>,
                     <&apps_smmu 0x18a0 0x40>,
                     <&apps_smmu 0x1860 0x00>;
            power-domains = <&camcc CAM_CC_IFE_0_GDSC>,
                            <&camcc CAM_CC_IFE_1_GDSC>,
                            <&camcc CAM_CC_IFE_2_GDSC>,
                            <&camcc CAM_CC_TITAN_TOP_GDSC>;
            power-domain-names = "ife0", "ife1", "ife2", "top";
            vdd-csiphy01-0p9-supply = <&vreg_0p9>;
            vdd-csiphy01-1p2-supply = <&vreg_1p2>;

            ports {
                #address-cells = <1>;
                #size-cells = <0>;

                port@1 {
                    reg = <1>;

                    csiphy1_ep: endpoint {
                        data-lanes = <0 1 2 3>;
                        remote-endpoint = <&camera_sensor>;
                    };
                };
            };
        };
    };
...
```

## Documentation/devicetree/bindings/regulator/awinic,aw37004.yaml
```yaml
# SPDX-License-Identifier: (GPL-2.0 OR BSD-2-Clause)
%YAML 1.2
---
$id: http://devicetree.org/schemas/regulator/awinic,aw37004.yaml#
$schema: http://devicetree.org/meta-schemas/core.yaml#

title: Awinic AW37004 Four-Channel LDO PMIC

maintainers:
  - Devajith V S <devajithvs@gmail.com>

description: |
  The AW37004 is a four-channel LDO PMIC for camera modules: two DVDD
  outputs in the 0.6-1.8 V range and two AVDD outputs in the 1.2-4.3 V
  range, programmed over I2C.

properties:
  compatible:
    const: awinic,aw37004

  reg:
    maxItems: 1

patternProperties:
  "^dvdd[12]$|^avdd[12]$":
    type: object
    $ref: regulator.yaml#
    unevaluatedProperties: false
    description:
      Properties for a single regulator output.

    required:
      - regulator-name

required:
  - compatible
  - reg
  - dvdd1
  - dvdd2
  - avdd1
  - avdd2

additionalProperties: false

examples:
  - |
    i2c {
        #address-cells = <1>;
        #size-cells = <0>;

        regulator@28 {
            compatible = "awinic,aw37004";
            reg = <0x28>;

            dvdd1 {
                regulator-name = "cam_dvdd1";
                regulator-min-microvolt = <1050000>;
                regulator-max-microvolt = <1050000>;
            };

            dvdd2 {
                regulator-name = "cam_dvdd2";
                regulator-min-microvolt = <1200000>;
                regulator-max-microvolt = <1200000>;
            };

            avdd1 {
                regulator-name = "cam_avdd1";
                regulator-min-microvolt = <2800000>;
                regulator-max-microvolt = <2800000>;
            };

            avdd2 {
                regulator-name = "cam_avdd2";
                regulator-min-microvolt = <2800000>;
                regulator-max-microvolt = <2800000>;
            };
        };
    };
...
```

## Documentation/devicetree/bindings/sound/nxp,tfa987x.yaml
```yaml
# SPDX-License-Identifier: (GPL-2.0-only OR BSD-2-Clause)
%YAML 1.2
---
$id: http://devicetree.org/schemas/sound/nxp,tfa987x.yaml#
$schema: http://devicetree.org/meta-schemas/core.yaml#

title: NXP TFA9873/TFA9874 speaker amplifiers

maintainers:
  - Devajith Valaparambil Sreeramaswamy <devajithvs@gmail.com>

description: |
  The TFA9873 and TFA9874 are Class-D speaker amplifiers with I2S/TDM input
  and an I2C control interface. They are smart amplifiers: the speaker
  protection runs on an internal DSP that has to be loaded with NXP's
  configuration container before playback. The device tree only describes the
  bus address, the reset line and the supply; the container is a firmware
  file, and the driver reports at probe which of the two parts answered.

properties:
  compatible:
    enum:
      - nxp,tfa9873
      - nxp,tfa9874

  reg:
    maxItems: 1

  reset-gpios:
    description: |
      Active-high reset line. The line is asserted high and released low.
    maxItems: 1

  vddd-supply:
    description: 1.8 V I/O and amplifier supply.

  '#sound-dai-cells':
    const: 0

required:
  - compatible
  - reg
  - reset-gpios
  - vddd-supply
  - '#sound-dai-cells'

additionalProperties: false

examples:
  - |
    #include <dt-bindings/gpio/gpio.h>

    i2c {
        #address-cells = <1>;
        #size-cells = <0>;

        speaker@34 {
            compatible = "nxp,tfa9873";
            reg = <0x34>;
            reset-gpios = <&tlmm 127 GPIO_ACTIVE_HIGH>;
            vddd-supply = <&vreg_l7b_1p8>;
            #sound-dai-cells = <0>;
        };
    };
...
```

## Documentation/devicetree/bindings/sound/qcom,q6apm-lpass-dais.yaml
```yaml
# SPDX-License-Identifier: GPL-2.0 OR BSD-2-Clause
%YAML 1.2
---
$id: http://devicetree.org/schemas/sound/qcom,q6apm-lpass-dais.yaml#
$schema: http://devicetree.org/meta-schemas/core.yaml#

title: Qualcomm DSP LPASS (Low Power Audio SubSystem) Audio Ports

maintainers:
  - Krzysztof Kozlowski <krzk@kernel.org>
  - Srinivas Kandagatla <srinivas.kandagatla@linaro.org>

allOf:
  - $ref: dai-common.yaml#

properties:
  compatible:
    enum:
      - qcom,q6apm-lpass-dais

  '#sound-dai-cells':
    const: 1

  clocks:
    description:
      LPASS interface clock of the secondary MI2S, driven by the LPASS PRM
      (q6prm). The DAI votes its frequency at hw_params; without the vote the
      DSP's I2S endpoint has no bit clock and never returns a buffer.
    maxItems: 1

  clock-names:
    items:
      - const: sec-mi2s-ibit

required:
  - compatible
  - '#sound-dai-cells'

unevaluatedProperties: false

examples:
  - |
    dais {
        compatible = "qcom,q6apm-lpass-dais";
        #sound-dai-cells = <1>;
    };
```
